/* USER CODE BEGIN Header */
/**
  ******************************************************************************
  * @file           : main.c
  * @brief          : Main program body
  ******************************************************************************
  * @attention
  *
  * Copyright (c) 2023 STMicroelectronics.
  * All rights reserved.
  *
  * This software is licensed under terms that can be found in the LICENSE file
  * in the root directory of this software component.
  * If no LICENSE file comes with this software, it is provided AS-IS.
  *
  ******************************************************************************
  */
/* USER CODE END Header */
/* Includes ------------------------------------------------------------------*/
#include "gpio.h"
#include "i2c.h"
#include "tim.h"
#include "usart.h"
#include <io/Keypad.hpp>
#include <display/Display.hpp>
#include <main.hpp>
#include <sensors/Ds18b20.hpp>
#include <io/FunctionTimer.hpp>
#include <io/Valve.hpp>
#include <io/Logger.hpp>

/* Private includes ----------------------------------------------------------*/
/* USER CODE BEGIN Includes */
#include <string>
#include <cstdio>
#include <cstdlib>
/* USER CODE END Includes */

/* Private typedef -----------------------------------------------------------*/
/* USER CODE BEGIN PTD */

/* USER CODE END PTD */

/* Private define ------------------------------------------------------------*/
/* USER CODE BEGIN PD */

/* USER CODE END PD */

/* Private macro -------------------------------------------------------------*/
/* USER CODE BEGIN PM */

/* USER CODE END PM */

/* Private variables ---------------------------------------------------------*/

/* USER CODE BEGIN PV */
io::Logger logger("Main");
/* USER CODE END PV */

/* Private function prototypes -----------------------------------------------*/
void SystemClock_Config(void);
/* USER CODE BEGIN PFP */

/* USER CODE END PFP */

/* Private user code ---------------------------------------------------------*/
/* USER CODE BEGIN 0 */

/* USER CODE END 0 */

/**
  * @brief  The application entry point.
  * @retval int
  */
int main(void)
{
    /* USER CODE BEGIN 1 */

    /* USER CODE END 1 */

    /* MCU Configuration--------------------------------------------------------*/

    /* Reset of all peripherals, Initializes the Flash interface and the Systick. */
    HAL_Init();

    /* USER CODE BEGIN init */

    /* USER CODE END init */

    /* Configure the system clock */
    SystemClock_Config();

    /* USER CODE BEGIN SysInit */

    /* USER CODE END SysInit */

    /* Initialize all configured peripherals */
    MX_GPIO_Init();
    MX_USART2_UART_Init();
    MX_I2C1_Init();
    MX_TIM1_Init();
    /* USER CODE BEGIN 2 */
    io::Keypad keypad{};

    io::GpioPin oneWirePin(DS18B20_GPIO_Port, DS18B20_Pin);
    communication::OneWire oneWire{oneWirePin, htim1};
    sensors::Ds18b20Collection ds_collection(oneWire, true);

    if(ds_collection.addSensors(config::ds_sensors, 12))
        logger.error() << "Error occurred when adding one or many DS18B20 sensors. Continuing..";

    display::Display display{ds_collection};
    display.init(&hi2c1);
    display.viewAction(config::Key::NONE);

    /* USER CODE END 2 */

    /* Infinite loop */
    /* USER CODE BEGIN WHILE */
    char buf[20];
    uint8_t pos;
    HAL_StatusTypeDef status;
    bool command_from_stdi = false;
    config::Key key;

    while (true)
    {
    	command_from_stdi = false;
        do
        {
            if(pos < 20)
            {
                status = HAL_UART_Receive(&huart2, (uint8_t *)(buf + pos), 1, 100);
                if (status == HAL_OK)
                {
                	if (buf[pos] == '\n')
                	{
                		buf[pos] = '\0';
                		++pos;
                		break;
                	}
                	++pos;
                }
            }
            else
            {
                buf[19] = '\0';
                pos = 19;
                break;
            }
        }
        while(status == HAL_OK);

        if(pos)
        {
            logger.info() << "Received string (" << std::to_string(pos) << "): " << std::string(buf, pos + 1) << '\n';
            key = config::toKey(std::string(buf));
            pos = 0;
            command_from_stdi = true;
        }

        switch (display.getCurrentView())
        {
            case display::DisplayView::EMPTY:
            case display::DisplayView::MAIN_MENU:
            case display::DisplayView::AC_LOW_RELAYS:
            case display::DisplayView::AC_HIGH_RELAYS:
            case display::DisplayView::DC_AC_RELAYS:
                if(!command_from_stdi or key == config::Key::NONE)
                {
                    key = keypad.waitForKey(config::keypad_debounce_time_ms);
                }

                if (key != config::Key::NONE) {
                    display.viewAction(key);
                }
                break;
            case display::DisplayView::TEMP_SENSORS:
                ds_collection.startRangingAll();
                if(ds_collection.readAll())
                {
                    logger.error() << "Error occurred when reading one or many DS18B20 sensor temperatures. Continuing..";
                }
                display.viewAction(keypad.waitForKey(1000));
                break;
            default:
                break;
        }

//        io::FunctionTimer::handleFunctionsWithTimeout();
        /* USER CODE END WHILE */

        /* USER CODE BEGIN 3 */
    }
    /* USER CODE END 3 */
}

/**
  * @brief System Clock Configuration
  * @retval None
  */
void SystemClock_Config(void)
{
    RCC_OscInitTypeDef RCC_OscInitStruct = {0};
    RCC_ClkInitTypeDef RCC_ClkInitStruct = {0};

    /** Configure the main internal regulator output voltage
  */
    __HAL_RCC_PWR_CLK_ENABLE();
    __HAL_PWR_VOLTAGESCALING_CONFIG(PWR_REGULATOR_VOLTAGE_SCALE2);

    /** Initializes the RCC Oscillators according to the specified parameters
  * in the RCC_OscInitTypeDef structure.
  */
    RCC_OscInitStruct.OscillatorType = RCC_OSCILLATORTYPE_HSI;
    RCC_OscInitStruct.HSIState = RCC_HSI_ON;
    RCC_OscInitStruct.HSICalibrationValue = RCC_HSICALIBRATION_DEFAULT;
    RCC_OscInitStruct.PLL.PLLState = RCC_PLL_ON;
    RCC_OscInitStruct.PLL.PLLSource = RCC_PLLSOURCE_HSI;
    RCC_OscInitStruct.PLL.PLLM = 16;
    RCC_OscInitStruct.PLL.PLLN = 336;
    RCC_OscInitStruct.PLL.PLLP = RCC_PLLP_DIV4;
    RCC_OscInitStruct.PLL.PLLQ = 7;
    if (HAL_RCC_OscConfig(&RCC_OscInitStruct) != HAL_OK)
    {
        Error_Handler();
    }

    /** Initializes the CPU, AHB and APB buses clocks
  */
    RCC_ClkInitStruct.ClockType = RCC_CLOCKTYPE_HCLK|RCC_CLOCKTYPE_SYSCLK
                                  |RCC_CLOCKTYPE_PCLK1|RCC_CLOCKTYPE_PCLK2;
    RCC_ClkInitStruct.SYSCLKSource = RCC_SYSCLKSOURCE_PLLCLK;
    RCC_ClkInitStruct.AHBCLKDivider = RCC_SYSCLK_DIV1;
    RCC_ClkInitStruct.APB1CLKDivider = RCC_HCLK_DIV2;
    RCC_ClkInitStruct.APB2CLKDivider = RCC_HCLK_DIV1;

    if (HAL_RCC_ClockConfig(&RCC_ClkInitStruct, FLASH_LATENCY_2) != HAL_OK)
    {
        Error_Handler();
    }
}

/* USER CODE BEGIN 4 */

/* USER CODE END 4 */

/**
  * @brief  This function is executed in case of error occurrence.
  * @retval None
  */
void Error_Handler(void)
{
    /* USER CODE BEGIN Error_Handler_Debug */
    /* User can add his own implementation to report the HAL error return state */
    __disable_irq();
    while (1)
    {
    }
    /* USER CODE END Error_Handler_Debug */
}

#ifdef  USE_FULL_ASSERT
/**
  * @brief  Reports the name of the source file and the source line number
  *         where the assert_param error has occurred.
  * @param  file: pointer to the source file name
  * @param  line: assert_param error line source number
  * @retval None
  */
void assert_failed(uint8_t *file, uint32_t line)
{
    /* USER CODE BEGIN 6 */
    /* User can add his own implementation to report the file name and line number,
     ex: printf("Wrong parameters value: file %s on line %d\r\n", file, line) */
    /* USER CODE END 6 */
}
#endif /* USE_FULL_ASSERT */
